## CMakeLists.txt
```
# Required by cmake
cmake_minimum_required(VERSION 3.13.1)

# Hardware definition
set(BOARD nrf52840dk_nrf52840)
set(CONFIG_UART_CONSOLE n CACHE STRING "Force no UART console")

# Define Zephyr's location in the repo.
if (NOT ZEPHYR_BASE)
    get_filename_component(ZEPHYR_BASE ${CMAKE_SOURCE_DIR}/../zephyr ABSOLUTE CACHE)
endif ()
# Find Zephyr. This also loads Zephyr's build system.
find_package(Zephyr REQUIRED NO_DEFAULT_PATH PATHS ${ZEPHYR_BASE})

project(GPIOTE-test)

# Add your source file to the "app" target. This must come after
# find_package(Zephyr) which defines the target.
target_sources(app PRIVATE
    src/main.c
    )
```

## prj.conf
```kconfig
CONFIG_GPIO=y
# CONFIG_RESET_ON_FATAL_ERROR is not set
CONFIG_NRFX_POWER=y
CONFIG_NRFX_PPI=y
CONFIG_NRFX_TIMER0=y
CONFIG_NRFX_TIMER1=y
CONFIG_SOC_SERIES_NRF52X=y
CONFIG_SOC_NRF52840_QIAA=y
CONFIG_NFCT_PINS_AS_GPIOS=y
# CONFIG_GPIO_AS_PINRESET is not set
CONFIG_ZERO_LATENCY_IRQS=y
CONFIG_ARM_MPU=y
CONFIG_HW_STACK_PROTECTION=y
CONFIG_EXTRA_EXCEPTION_INFO=y
CONFIG_CONSOLE=y
CONFIG_RTT_CONSOLE=y
CONFIG_USE_SEGGER_RTT=y
CONFIG_SEGGER_RTT_MAX_NUM_UP_BUFFERS=1
CONFIG_SEGGER_RTT_MAX_NUM_DOWN_BUFFERS=1
CONFIG_SEGGER_RTT_BUFFER_SIZE_UP=2048
CONFIG_SEGGER_RTT_PRINTF_BUFFER_SIZE=2048
CONFIG_SYSTEM_CLOCK_DISABLE=y
CONFIG_HWINFO=y
CONFIG_RING_BUFFER=y
CONFIG_STACK_USAGE=y
CONFIG_STACK_SENTINEL=y
CONFIG_DEBUG_INFO=y
CONFIG_LOG=y
CONFIG_LOG_BACKEND_RTT_MODE_DROP=y
CONFIG_LOG_BACKEND_RTT_MESSAGE_SIZE=256
CONFIG_DEBUG_OPTIMIZATIONS=y
CONFIG_ASSERT_ON_ERRORS=y
```

## nrf52840dk_nrf52840.overlay
```dts
/ {
    chosen {
		/delete-property/ zephyr,shell-uart;
		/delete-property/ zephyr,uart-mcumgr;
		/delete-property/ zephyr,bt-mon-uart;
		/delete-property/ zephyr,bt-c2h-uart;
    };
};
```

## src/main.c
```c
//
// Created by Benjamin Riggs on 6/11/21.
//

#include <logging/log.h>
#include <hal/nrf_gpio.h>
#include <nrfx_timer.h>
#include <nrfx_gpiote.h>
#include <nrfx_ppi.h>

LOG_MODULE_REGISTER(GPIOTE_test, LOG_LEVEL_INF);

#define APP_ERROR_CHECK(FN) \
do {              \
    int err = (FN);     \
    if (err != NRFX_SUCCESS) { \
          LOG_ERR( #FN " failed with %d", err); \
          return -1;\
    }\
} while(0)

#define LED1_PIN    13
#define LED2_PIN    14
#define LED3_PIN    15
#define LED4_PIN    16

static nrfx_timer_t const m_timer0 = NRFX_TIMER_INSTANCE(0);
static nrfx_timer_t const m_timer1 = NRFX_TIMER_INSTANCE(1);

static void pulse_timer_irq_evt_handler(nrf_timer_event_t __unused event_type, void __unused *p_context) {}

int timer_init(void) {
    nrfx_timer_config_t timer_config = NRFX_TIMER_DEFAULT_CONFIG;
    timer_config.frequency = NRF_TIMER_FREQ_1MHz;
    timer_config.mode = NRF_TIMER_MODE_TIMER;
    timer_config.bit_width = NRF_TIMER_BIT_WIDTH_32;

    APP_ERROR_CHECK(nrfx_timer_init(&m_timer0, &timer_config, pulse_timer_irq_evt_handler));
    APP_ERROR_CHECK(nrfx_timer_init(&m_timer1, &timer_config, pulse_timer_irq_evt_handler));
    return 0;
}

int gpiote_init(void) {
    APP_ERROR_CHECK(nrfx_gpiote_init(7));

    uint32_t task_addr;
    uint32_t evt_addr;
    nrf_ppi_channel_t ppi_channel[2][2];

    nrfx_gpiote_out_config_t gpiote_config = NRFX_GPIOTE_CONFIG_OUT_TASK_TOGGLE(false);

#define SET_PPI(T, C) \
APP_ERROR_CHECK(nrfx_ppi_channel_alloc(&ppi_channel[T][C])); \
APP_ERROR_CHECK(nrfx_ppi_channel_assign(ppi_channel[T][C], evt_addr, task_addr)); \
APP_ERROR_CHECK(nrfx_ppi_channel_enable(ppi_channel[T][C]))

    // Toggle LED 1 on timer0 channels 0 & 1
    APP_ERROR_CHECK(nrfx_gpiote_out_init(LED1_PIN, &gpiote_config));
    task_addr = nrfx_gpiote_out_task_addr_get(LED1_PIN);
    evt_addr = nrfx_timer_compare_event_address_get(&m_timer0, 0);
    SET_PPI(0, 0);
    evt_addr = nrfx_timer_compare_event_address_get(&m_timer0, 1);
    SET_PPI(0, 1);
    // Toggle LED 2 on PPI FORK of PPI triggered by timer0 channel 1
    APP_ERROR_CHECK(nrfx_gpiote_out_init(LED2_PIN, &gpiote_config));
    task_addr = nrfx_gpiote_out_task_addr_get(LED2_PIN);
    APP_ERROR_CHECK(nrfx_ppi_channel_fork_assign(ppi_channel[0][1], task_addr));

    // Toggle LED 3 on timer1 channel 0
    APP_ERROR_CHECK(nrfx_gpiote_out_init(LED3_PIN, &gpiote_config));
    task_addr = nrfx_gpiote_out_task_addr_get(LED3_PIN);
    evt_addr = nrfx_timer_compare_event_address_get(&m_timer1, 0);
    SET_PPI(1, 0);
    evt_addr = nrfx_timer_compare_event_address_get(&m_timer1, 1);
    SET_PPI(1, 1);
    // Toggle LED 4 on PPI FORK of PPI triggered by timer1 channel 0
    APP_ERROR_CHECK(nrfx_gpiote_out_init(LED4_PIN, &gpiote_config));
    task_addr = nrfx_gpiote_set_task_addr_get(LED4_PIN);
    APP_ERROR_CHECK(nrfx_ppi_channel_fork_assign(ppi_channel[1][1], task_addr));
    task_addr = nrfx_gpiote_clr_task_addr_get(LED4_PIN);
    APP_ERROR_CHECK(nrfx_ppi_channel_fork_assign(ppi_channel[1][0], task_addr));

    nrfx_gpiote_out_task_enable(LED1_PIN);
    nrfx_gpiote_out_task_enable(LED2_PIN);
    nrfx_gpiote_out_task_enable(LED3_PIN);
    nrfx_gpiote_out_task_enable(LED4_PIN);

    return 0;
}

void main(void) {

    int ret;
    ret = timer_init();
    if (ret) return;
    ret = gpiote_init();
    if (ret) return;

    nrfx_timer_extended_compare(&m_timer0, 0, 1000000, 0, false);
    nrfx_timer_extended_compare(&m_timer0, 1, 2000000, NRF_TIMER_SHORT_COMPARE1_CLEAR_MASK, false);

    nrfx_timer_extended_compare(&m_timer1, 0, 1000000, 0, false);
    nrfx_timer_extended_compare(&m_timer1, 1, 2000000, NRF_TIMER_SHORT_COMPARE1_CLEAR_MASK, false);

    nrfx_timer_enable(&m_timer0);
    nrfx_timer_enable(&m_timer1);
}
```
